## Kconfig
```kconfig
mainmenu "Debian Webruntime Images"

config KAS_INCLUDE_MAIN
  string
  default "kas/kas-webruntime.yml"

config KAS_BUILD_SYSTEM
  string
  default "isar"

config ARCH_AMD64
  bool

config ARCH_ARM64
	bool

choice
  prompt "Target board"
  default TARGET_X86_UEFI

config TARGET_X86_UEFI
  bool "Generic x86 machine booting via UEFI"
  select ARCH_AMD64

config TARGET_INTEL_NUC
  bool "Intel NUC (NUC8i7BEH)"
  select ARCH_AMD64

config TARGET_RPI_5
  bool "Raspberry Pi 5"
  select ARCH_ARM64


endchoice

config KAS_INCLUDE_BOARD
  string
  default "kas/board/x86-uefi.yml" if TARGET_X86_UEFI
  default "kas/board/intel-nuc.yml" if TARGET_INTEL_NUC
  default "kas/board/rpi5.yml" if TARGET_RPI_5

comment "Debian distribution options"

choice
  prompt "Debian Release"
  default DEBIAN_BOOKWORM

config DEBIAN_BOOKWORM
  bool "Bookworm (12)"

endchoice

config KAS_INCLUDE_DEBIAN
  string
  default "kas/opt/debian12.yml" if DEBIAN_BOOKWORM && !TARGET_RPI_5
  default "kas/opt/raspios-debian12.yml" if DEBIAN_BOOKWORM && TARGET_RPI_5

comment "Webruntime type options"

choice
  prompt "Webengine type"
  default WEBRUNTIME_WPEWEBKIT

config WEBRUNTIME_WPEWEBKIT
  bool "WPEWebKit (2.50.4)"
  help
    WPEWebKit based webruntime.

config WEBRUNTIME_LADYBIRD
  bool "Ladybird (Dec 10, 2025)"
  help
    Ladybird based webruntime.

endchoice

config KAS_INCLUDE_WEBRUNTIME
  string
  default "kas-wpewebkit.yml" if WEBRUNTIME_WPEWEBKIT
  default "kas-ladybird.yml" if WEBRUNTIME_LADYBIRD
```

## conf/distro/debian12.conf
```bitbake
require conf/distro/debian-bookworm.conf

DISTRO_APT_SOURCES += " conf/distro/debian12-backports.list"
DISTRO_APT_SOURCES += " conf/distro/debian12-llvm.list"
DISTRO_APT_PREFERENCES += "conf/distro/preferences.debian12-backports.conf"

LLVM_KEY = "https://apt.llvm.org/llvm-snapshot.gpg.key;sha256sum=ce6eee4130298f79b0e0f09a89f93c1bc711cd68e7e3182d37c8e96c5227e2f0"
DISTRO_BOOTSTRAP_KEYS += " ${LLVM_KEY}"
HOST_DISTRO_BOOTSTRAP_KEYS += " ${LLVM_KEY}"

KODEGOOD_KEY = "https://kodegood.github.io/debian-backports/kodegood-debian-backports.gpg.key;sha256sum=354101b6799cfc0964d2913c43898e4f2dc0c42bcaec40dabd154ea106ccdb5c"
THIRD_PARTY_APT_KEYS += "${KODEGOOD_KEY}"

DISTRO_CLANG = "20"

PREFERRED_VERSION_skia = "129"
```

## conf/distro/raspios-debian12.conf
```bitbake
BASE_DISTRO = "raspios64"

HOST_BASE_DISTRO = "debian"

BASE_DISTRO_CODENAME = "bookworm"

HOST_DISTRO = "debian-bookworm"
HOST_DISTRO_APT_SOURCES = "conf/distro/${HOST_DISTRO}.list"
HOST_DISTRO_APT_SOURCES += "conf/distro/debian12-backports.list"
HOST_DISTRO_APT_SOURCES += "conf/distro/debian12-llvm.list"
HOST_DISTRO_APT_PREFERENCES += "conf/distro/preferences.debian12-backports.conf"

DISTRO_APT_SOURCES = "conf/distro/raspios-debian12.list"
DISTRO_APT_SOURCES += "conf/distro/debian12-backports.list"
DISTRO_APT_SOURCES += "conf/distro/debian12-llvm.list"
DISTRO_APT_PREFERENCES += "conf/distro/preferences.debian12-backports.conf"

DISTRO_KERNELS = "rpi-v8 rpi-2712"

LLVM_KEY = "https://apt.llvm.org/llvm-snapshot.gpg.key;sha256sum=ce6eee4130298f79b0e0f09a89f93c1bc711cd68e7e3182d37c8e96c5227e2f0"
HOST_DISTRO_BOOTSTRAP_KEYS += "${LLVM_KEY}"
DISTRO_BOOTSTRAP_KEYS += "${LLVM_KEY}"

RPI_KEY = "http://archive.raspberrypi.org/debian/raspberrypi.gpg.key;sha256sum=76603890d82a492175caf17aba68dc73acb1189c9fd58ec0c19145dfa3866d56"
THIRD_PARTY_APT_KEYS += "${RPI_KEY}"

KODEGOOD_KEY = "https://kodegood.github.io/debian-backports/kodegood-debian-backports.gpg.key;sha256sum=354101b6799cfc0964d2913c43898e4f2dc0c42bcaec40dabd154ea106ccdb5c"
THIRD_PARTY_APT_KEYS += "${KODEGOOD_KEY}"

DISTRO_GCC = "12"
DISTRO_CLANG = "20"

PREFERRED_VERSION_skia = "129"

DISTROOVERRIDES:append = ":debian12"
```
